## Config.in
```kconfig
menu "CCTV Secure Firmware (국정원 보안기능확인서 대응)"
	source "$BR2_EXTERNAL_IPCAMERA_SECURE_PATH/package/cctv-secd/Config.in"
	source "$BR2_EXTERNAL_IPCAMERA_SECURE_PATH/package/crypto-hal/Config.in"
	source "$BR2_EXTERNAL_IPCAMERA_SECURE_PATH/package/rtsp-server/Config.in"
endmenu
```

## configs/rpi5_secure_defconfig
```kconfig
# [참고용 단독 스케치] — 권장 경로는 scripts/setup.sh (raspberrypi5_defconfig + fragment 병합).
# 이 파일은 옵션을 한눈에 보기 위한 참고본이며, 실제 빌드는 configs/ipcamera_secure.fragment
# 를 raspberrypi5_defconfig 에 병합하는 방식을 쓴다(BUILD.md 참고). 커널 pin 등은 미검증.
# RPi5(2GB)+IMX219 보안 IP카메라 펌웨어 defconfig (뼈대)

# --- 아키텍처 (RPi5 = BCM2712, Cortex-A76) ---
BR2_aarch64=y
BR2_cortex_a76=y

# --- 툴체인 ---
BR2_TOOLCHAIN_BUILDROOT_GLIBC=y
BR2_TOOLCHAIN_BUILDROOT_CXX=y

# --- 커널 (RPi 다운스트림: 카메라/IMX219 지원) ---
BR2_LINUX_KERNEL=y
BR2_LINUX_KERNEL_CUSTOM_TARBALL=y
# BR2_LINUX_KERNEL_CUSTOM_TARBALL_LOCATION="<RPi 커널 pin>"  # TODO: 버전 고정(재현성)
BR2_LINUX_KERNEL_DEFCONFIG="bcm2712"
# SFR:5.2.2 커널/커널모듈 무결성: 모듈 서명 + lockdown (kernel fragment)
BR2_LINUX_KERNEL_NEEDS_HOST_OPENSSL=y
# CONFIG_MODULE_SIG_FORCE / CONFIG_SECURITY_LOCKDOWN_LSM 은 커널 config fragment 로 강제

# --- 부트 (RPi5 펌웨어 + U-Boot FIT 서명) ---
BR2_PACKAGE_RPI_FIRMWARE=y
BR2_TARGET_UBOOT=y
# BR2_TARGET_UBOOT_NEEDS_OPENSSL=y  # FIT 서명

# --- rootfs: 읽기전용 squashfs + dm-verity (5.2.1 무결성) ---
BR2_TARGET_ROOTFS_SQUASHFS=y
BR2_TARGET_ROOTFS_SQUASHFS4_XZ=y
# ext4 등 쓰기 rootfs 비활성 (불변)
# dm-verity 해시는 post-image 에서 veritysetup 로 생성

# --- 카메라 (IMX219) ---
BR2_PACKAGE_LIBCAMERA=y
BR2_PACKAGE_LIBCAMERA_APPS=y
# IMX219 device-tree overlay 는 rpi-firmware config.txt (rootfs-overlay)

# --- 영상 스트리밍 (RPi5 HW H.264 인코더 없음 → 소프트 인코딩) ---
BR2_PACKAGE_GSTREAMER1=y
BR2_PACKAGE_GST1_PLUGINS_GOOD=y
BR2_PACKAGE_GST1_PLUGINS_BAD=y
BR2_PACKAGE_GST1_LIBAV=y
# RTSP 서버(1.1.1 인증 + 1.2.1 RTSPS): mediamtx (package/rtsp-server)
BR2_PACKAGE_GST1_PLUGINS_UGLY=y   # x264enc (소프트 H.264)

# --- 웹 관리 UI (경량, 비-WAS) ---
BR2_PACKAGE_LIGHTTPD=y
BR2_PACKAGE_LIGHTTPD_OPENSSL=y

# --- 암호 (crypto HAL 백엔드: 프로토타입 OpenSSL/ARIA) ---
BR2_PACKAGE_OPENSSL=y
BR2_PACKAGE_LIBOPENSSL=y

# --- 네트워크 하드닝 ---
BR2_PACKAGE_NFTABLES=y
BR2_PACKAGE_CHRONY=y            # 8.1.3 신뢰 시간(인증 NTP)
BR2_PACKAGE_OPENSSH=y           # 관리 접속(키기반). telnet/ftp 미포함

# --- 저장 암호화 / 무결성 ---
BR2_PACKAGE_CRYPTSETUP=y        # 4.2.1 저장 암호화 + dm-verity(veritysetup)

# --- 서명 A/B OTA 업데이트 (6.1.x) ---
BR2_PACKAGE_RAUC=y

# --- 이미지 생성 (A/B 파티션) ---
BR2_PACKAGE_HOST_GENIMAGE=y
BR2_PACKAGE_HOST_DOSFSTOOLS=y
BR2_PACKAGE_HOST_MTOOLS=y

# --- 커스텀: 보안 데몬 · RTSP 서버 ---
BR2_PACKAGE_CCTV_SECD=y
BR2_PACKAGE_CRYPTO_HAL=y
BR2_PACKAGE_RTSP_SERVER=y

# --- rootfs 오버레이(하드닝 설정) + post 스크립트 ---
BR2_ROOTFS_OVERLAY="$(BR2_EXTERNAL_IPCAMERA_SECURE_PATH)/board/rpi5-secure/rootfs-overlay"
BR2_ROOTFS_POST_BUILD_SCRIPT="$(BR2_EXTERNAL_IPCAMERA_SECURE_PATH)/board/rpi5-secure/post-build.sh"
BR2_ROOTFS_POST_IMAGE_SCRIPT="$(BR2_EXTERNAL_IPCAMERA_SECURE_PATH)/board/rpi5-secure/post-image.sh"

# --- 최소화(10.3.1 불필요 서비스 제거): 아래는 넣지 않음 ---
# telnet, ftp, avahi/mDNS, python, 개발도구, 불필요 데몬
```

## package/cctv-secd/Config.in
```kconfig
config BR2_PACKAGE_CCTV_SECD
	bool "cctv-secd (보안 데몬)"
	select BR2_PACKAGE_OPENSSL
	select BR2_PACKAGE_CRYPTO_HAL
	help
	  국정원 보안기능확인서 대응 보안 데몬(PoC).
	  프로비저닝(firstboot)·자체시험/무결성·감사기록·세션 관리를 담당.
	  각 기능은 소스에 SFR:<항목ID> 태그로 요구항목과 연결됨.
```

## package/crypto-hal/Config.in
```kconfig
config BR2_PACKAGE_CRYPTO_HAL
	bool "crypto-hal (암호 추상화 계층)"
	select BR2_PACKAGE_OPENSSL
	help
	  crypto_provider HAL. 프로토타입=OpenSSL(ARIA256-GCM 1순위) 백엔드,
	  양산=KCMVP 검증필 모듈로 백엔드만 교체. AEAD/해시/키관리만 노출해
	  ECB·고정IV·금지 알고리즘을 원천 차단. (SFR:9.1.1~9.4.1, 4.2.1)
```

## package/rtsp-server/Config.in
```kconfig
config BR2_PACKAGE_RTSP_SERVER
	bool "rtsp-server (mediamtx, 인증 + RTSPS)"
	help
	  IMX219 영상 스트리밍용 RTSP 서버(mediamtx).
	  익명 접근을 막는 사용자 인증(SFR:1.1.1)과 RTSPS(RTSP over TLS)
	  암호전송(SFR:1.2.1)을 강제하는 하드닝 설정으로 배포한다.
	  RPi5는 HW H.264 인코더가 없어 소프트웨어 인코딩(libcamera→gstreamer)을 사용.
```
